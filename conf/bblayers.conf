## conf/bblayers.conf
```bitbake
# POKY_BBLAYERS_CONF_VERSION is increased each time build/conf/bblayers.conf
# changes incompatibly
POKY_BBLAYERS_CONF_VERSION = "2"

BBPATH = "${TOPDIR}"
BBFILES ?= ""

BBLAYERS ?= " \
  /home/aus/Documents/yoctoLearning/poky/meta \
  /home/aus/Documents/yoctoLearning/poky/meta-poky \
  /home/aus/Documents/yoctoLearning/poky/meta-yocto-bsp \
  /home/aus/Documents/yoctoLearning/poky/meta-raspberrypi \
  /home/aus/Documents/yoctoLearning/poky/meta-openembedded/meta-oe \
  /home/aus/Documents/yoctoLearning/poky/meta-openembedded/meta-python \
  /home/aus/Documents/yoctoLearning/poky/meta-feather \
  "
```

## meta-feather/conf/layer.conf
```bitbake
# We have a conf and classes directory, add to BBPATH
BBPATH .= ":${LAYERDIR}"

# We have recipes-* directories, add to BBFILES
BBFILES += "${LAYERDIR}/recipes-*/*/*.bb \
            ${LAYERDIR}/recipes-*/*/*.bbappend"

BBFILE_COLLECTIONS += "meta-feather"
BBFILE_PATTERN_meta-feather = "^${LAYERDIR}/"
BBFILE_PRIORITY_meta-feather = "6"

LAYERDEPENDS_meta-feather = "core"
LAYERSERIES_COMPAT_meta-feather = "scarthgap"
```
